## c6_fw/main/Kconfig.projbuild
```kconfig
menu "sPod C6 Upload Bridge"

    config SPOD_C6_WIFI_SSID
        string "Wi-Fi STA SSID"
        default ""
        help
            SSID used by the ESP32-C6 in station mode for upload service.

    config SPOD_C6_WIFI_PASSWORD
        string "Wi-Fi STA Password"
        default ""
        help
            Password used by the ESP32-C6 in station mode.

    config SPOD_C6_WIFI_CONNECT_TIMEOUT_MS
        int "Wi-Fi connect timeout (ms)"
        default 12000
        range 1000 120000
        help
            Time to wait for STA connection before reporting timeout.

    config SPOD_C6_WIFI_MAX_RETRY
        int "Wi-Fi max retry"
        default 8
        range 0 50
        help
            Number of retries after station disconnect events.

    config SPOD_C6_HTTP_PORT
        int "HTTP port"
        default 80
        range 1 65535
        help
            Web UI/API port for story upload.

    config SPOD_C6_UART_PORT
        int "UART port for P4 bridge"
        default 1
        range 0 1
        help
            UART instance used to send upload data to ESP32-P4.

    config SPOD_C6_UART_TX_GPIO
        int "UART TX GPIO (C6 -> P4)"
        default 16
        range 0 30
        help
            GPIO used for TX toward ESP32-P4 RX.

    config SPOD_C6_UART_RX_GPIO
        int "UART RX GPIO (P4 -> C6)"
        default 17
        range 0 30
        help
            GPIO used for RX from ESP32-P4 TX.

    config SPOD_C6_UART_BAUDRATE
        int "UART baudrate"
        default 921600
        range 9600 5000000
        help
            Bridge UART baudrate used by C6 and P4.

endmenu
```
